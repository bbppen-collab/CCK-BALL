## config/west.yml
```yaml
manifest:
  remotes:
    - name: zmkfirmware
      url-base: https://github.com/imhy123
    - name: bbppen-collab
      url-base: https://github.com/bbppen-collab
  projects:
    - name: zmk
      remote: zmkfirmware
      revision: v0.3-branch
      import: app/west.yml
    - name: zmk-pmw3610-driver
      remote: bbppen-collab
      revision: main
      
  self:
    path: config
```
